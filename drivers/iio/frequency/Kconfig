## drivers/iio/frequency/Kconfig
```kconfig
# SPDX-License-Identifier: GPL-2.0-only
#
# Frequency
#	Direct Digital Synthesis drivers (DDS)
#	Clock Distribution device drivers
#	Phase-Locked Loop (PLL) frequency synthesizers
#
# When adding new entries keep the list in alphabetical order

menu "Frequency Synthesizers DDS/PLL"

menu "Clock Generator/Distribution"

config AD9508
	tristate "Analog Devices AD9508 Clock Fanout Buffer"
	depends on SPI
	help
	  Say yes here to build support for Analog Devices AD9508 Clock Fanout Buffer with
	  Output Dividers and Delay Adjust. The driver provides direct access via sysfs.

	  To compile this driver as a module, choose M here: the
	  module will be called ad9508.

config AD9523
	tristate "Analog Devices AD9523 Low Jitter Clock Generator"
	depends on SPI
	depends on COMMON_CLK
	help
	  Say yes here to build support for Analog Devices AD9523 Low Jitter
	  Clock Generator. The driver provides direct access via sysfs.

	  To compile this driver as a module, choose M here: the
	  module will be called ad9523.

config AD9528
	tristate "Analog Devices AD9528 Low Jitter Clock Generator"
	depends on SPI
	depends on COMMON_CLK
	help
	  Say yes here to build support for Analog Devices AD9528 Low Jitter
	  Clock Generator. The driver provides direct access via sysfs.

	  To compile this driver as a module, choose M here: the
	  module will be called ad9528.

config AD9548
	tristate "Analog Devices AD9548 Network Clock Generator/Synchronizer"
	depends on SPI
	help
	  Say yes here to build support for Analog Devices AD9548
	  Quad/Octal Input Network Clock Generator/Synchronizer.

	  To compile this driver as a module, choose M here: the
	  module will be called ad9548.

config AD9517
	tristate "Analog Devices AD9517 12-Output Clock Generator"
	depends on SPI
	depends on COMMON_CLK
	help
	  Say yes here to build support for Analog Devices AD9517
	  12-Output Clock Generator.

	  To compile this driver as a module, choose M here: the
	  module will be called ad9517.

config ADMV1013
	tristate "Analog Devices ADMV1013 Microwave Upconverter"
	depends on SPI
	depends on COMMON_CLK
	depends on OF
	help
	  Say yes here to build support for Analog Devices ADMV1013
	  24 GHz to 44 GHz, Wideband, Microwave Upconverter.

	  To compile this driver as a module, choose M here: the
	  module will be called admv1013.

config ADMV1014
	tristate "Analog Devices ADMV1014 Microwave Downconverter"
	depends on SPI
	depends on COMMON_CLK
	depends on OF
	help
	  Say yes here to build support for Analog Devices ADMV1014
	  24 GHz to 44 GHz, Wideband, Microwave Downconverter.

	  To compile this driver as a module, choose M here: the
	  module will be called admv1014.

config ADMV4420
	tristate "Analog Devices ADMV4420 K Band Downconverter"
	depends on SPI
	depends on COMMON_CLK
	depends on OF
	help
	  Say yes here to build support for Analog Devices K Band Downconverter with
	  Integrated Fractional-N PLL and VCO.

	  To compile this driver as a module, choose M here: the
	  module will be called admv4420.

config ADRF6780
        tristate "Analog Devices ADRF6780 Microwave Upconverter"
        depends on SPI
        depends on COMMON_CLK
        depends on OF
        help
          Say yes here to build support for Analog Devices ADRF6780
          5.9 GHz to 23.6 GHz, Wideband, Microwave Upconverter.

          To compile this driver as a module, choose M here: the
          module will be called adrf6780.

config HMC7044
	tristate "Analog Devices HMC7044, HMC7043 Clock Jitter Attenuator with JESD204B"
	depends on SPI
	depends on COMMON_CLK
	help
	  Say yes here to build support for Analog Devices HMC7044, HMC7043
	  Clock Jitter Attenuator with JESD204B.
	  The driver provides direct access via sysfs.

	  To compile this driver as a module, choose M here: the
	  module will be called hmc7044.

config LTC6952
	tristate "Analog Devices LTC6952 Clock Ultralow Jitter with JESD204B/C"
	depends on SPI
	depends on COMMON_CLK
	help
	  Say yes here to build support for Analog Devices LTC6952 Clock Ultralow
	  Jitter Attenuator with JESD204B/C. The driver provides direct access
	  via sysfs.

	  To compile this driver as a module, choose M here: the
	  module will be called ltc6952.

config LMK04805
        tristate "Texas Instruments LMK04805 12-Output Clock Generator"
        depends on SPI
        depends on COMMON_CLK
        help
          Say yes here to build support for Texas Instruments LMK04805
          12-Output Clock Generator.

          To compile this driver as a module, choose M here: the
          module will be called lmk04805.

config LMK04832
        tristate "Texas Instruments LMK04832 12-Output Clock Generator"
        depends on SPI
        depends on COMMON_CLK
        help
          Say yes here to build support for Texas Instruments LMK04832
          12-Output Clock Generator.

          To compile this driver as a module, choose M here: the
          module will be called lmk04832.

endmenu

menu "Direct Digital Synthesis"

config CF_AXI_DDS
	tristate "Analog Devices CoreFPGA AXI DDS driver"
	depends on SPI
	depends on COMMON_CLK
	select IIO_BUFFER_DMAENGINE
	help
	  Say yes here to build support for Analog Devices DDS chip
	  AD9122, provides direct access via sysfs.

config CF_AXI_DDS_AD9122
	tristate "Analog Devices AD9122 DAC"
	depends on CF_AXI_DDS
	help
	  Say yes here to build support for Analog Devices AD9122 DAC chip
	  ad9122, provides direct access via sysfs.

config CF_AXI_DDS_AD9144
	tristate "Analog Devices AD9144 DAC"
	depends on CF_AXI_DDS
	select REGMAP_SPI
	help
	  Say yes here to build support for Analog Devices AD9144 DAC chip
	  ad9144, provides direct access via sysfs.

config CF_AXI_DDS_AD9162
	tristate "Analog Devices AD9162 DAC"
	depends on CF_AXI_DDS
	help
	  Say yes here to build support for Analog Devices AD9162 DAC chip
	  ad9162, provides direct access via sysfs.

config CF_AXI_DDS_AD9172
	tristate "Analog Devices AD917x DAC"
	depends on CF_AXI_DDS
	help
	  Say yes here to build support for Analog Devices AD917x DAC chip
	  ad917x, provides direct access via sysfs.

config CF_AXI_DDS_AD9739A
	tristate "Analog Devices AD9739A DAC"
	depends on CF_AXI_DDS
	help
	  Say yes here to build support for Analog Devices AD9739A DAC chip
	  ad9739a, provides direct access via sysfs.

config CF_AXI_DDS_AD9783
	tristate "Analog Devices AD9783 DAC"
	depends on CF_AXI_DDS
	help
	  Say yes here to build support for Analog Devices AD9783 DAC family,
	  provides direct access via sysfs.

	  The AD9780/AD9781/AD9783 include pin-compatible, high
	  dynamic range, dual digital-to-analog converters (DACs) with
	  12-/14-/16-bit resolutions, and sample rates of up to 500 MSPS.

config M2K_DAC
	tristate "Analog Devices M2K DAC"
	depends on CF_AXI_DDS
	help
	  Say yes here to build support for Analog Devices M2K platform DAC buffer
	  output.

config DDC_DUC
	tristate "Digital Down Converter (DDC) and Digital Up Converter (DUC) FPGA-IP driver"
	help
	  Say yes here to build support for Digital Down Converter (DDC)
	  and Digital Up Converter (DUC) FPGA-IP driver

	  To compile this driver as a module, choose M here: the
	  module will be called ddc_duc.

config DRAS_FM_DAB_ADC_DAC
	tristate "DRAS FM+DAB ADC/DAC FPGA-IP driver"
	help
	  Say yes here to build support for DRAS FM+DAB ADC/DAC FPGA-IP driver

	  To compile this driver as a module, choose M here: the
	  module will be called dras_fm_dab_adc_dac.

config DRAS_FM_REPEATER
	tristate "DRAS FM REPEATER FPGA-IP driver"
	help
	  Say yes here to build support for DRAS FM REPEATER FPGA-IP driver

	  To compile this driver as a module, choose M here: the
	  module will be called dras_fm_repeater.

config DRAS_FM_MOD_RDS
	tristate "DRAS FM MOD RDS FPGA-IP driver"
	help
	  Say yes here to build support for DRAS FM MOD RDS FPGA-IP driver

	  To compile this driver as a module, choose M here: the
	  module will be called dras_fm_mod_rds.

config DRAS_TETRA
	tristate "DRAS TETRA FPGA-IP driver"
	help
	  Say yes here to build support for DRAS TETRA FPGA-IP driver

	  To compile this driver as a module, choose M here: the
	  module will be called dras_tetra.

config DRAS_RADIO_REPEATER
	tristate "DRAS RADIO REPEATER FPGA-IP driver"
	help
	  Say yes here to build support for DRAS RADIO REPEATER FPGA-IP driver

	  To compile this driver as a module, choose M here: the
	  module will be called dras_radio_repeater.

config DRAS_TETRA_REPEATER
	tristate "DRAS TETRA REPEATER FPGA-IP driver"
	help
	  Say yes here to build support for DRAS TETRA REPEATER FPGA-IP driver

	  To compile this driver as a module, choose M here: the
	  module will be called dras_tetra_repeater.

config VBI_FM_DSP
	tristate "FM Voice break-in (VBI) FPGA-IP driver"
	help
	  Say yes here to build support for FM VBI FPGA-IP driver

	  To compile this driver as a module, choose M here: the
	  module will be called vbi_fm_dsp.

config VBI_FSK_DSP
	tristate "FSK 32 CHANNEL RECEIVER FPGA-IP driver"
	help
	  Say yes here to build support for FSK 32CH FPGA-IP driver

	  To compile this driver as a module, choose M here: the
	  module will be called vbi_fsk_dsp.

config VBI_DAB_DSP
	tristate "DAB Voice break-in (VBI) FPGA-IP driver"
	help
	  Say yes here to build support for DAB VBI FPGA-IP driver

	  To compile this driver as a module, choose M here: the
	  module will be called vbi_dab_dsp.

config VBI_FeMBMS_DSP
	tristate "FeMBMS Repeater FPGA-IP driver"
	help
	  Say yes here to build support for FeMBMS VBI FPGA-IP driver

	  To compile this driver as a module, choose M here: the
	  module will be called vbi_fembms_dsp.

config PCW_SDR_DSP
	tristate "PCW SDR DSP FPGA-IP driver"
	help
	  Say yes here to build support for PCW SDR DSP FPGA-IP driver

	  To compile this driver as a module, choose M here: the
	  module will be called directional_finder.

config VBI_BR_DSP
	tristate "PCW Broadcast Receiver DSP FPGA-IP driver"
	help
	  Say yes here to build support for PCW Broadcast Receiver DSP FPGA-IP driver

	  To compile this driver as a module, choose M here: the
	  module will be called vbi_br_dsp.

config FMCW_DDC
	tristate "FMCW DDC FPGA-IP driver"
	help
	  Say yes here to build support for FMCW DDC FPGA-IP driver

	  To compile this driver as a module, choose M here: the
	  module will be called fmcw_ddc.

config PCW_WBRX
	tristate "PCW WBRX driver"
	help
	  Say yes here to build support for PCW WBRX driver

	  To compile this driver as a module, choose M here: the
	  module will be called pcw_wbrx.

config PCW_FMCW_DSP
	tristate "PCW SDR DSP FPGA-IP driver"
	help
	  Say yes here to build support for PCW FMCW DSP FPGA-IP driver

	  To compile this driver as a module, choose M here: the
	  module will be called directional_finder.

config ZEBU_FMCW_DSP
	tristate "ZEBU SDR DSP FPGA-IP driver"
	help
	  Say yes here to build support for ZEBU FMCW DSP FPGA-IP driver

	  To compile this driver as a module, choose M here: the
	  module will be called directional_finder.

config DEXTER_DSP_TX
	tristate "DEXTER SDR DSP FPGA-IP driver"
	help
	  Say yes here to build support for DEXTER DSP TX FPGA-IP driver

	  To compile this driver as a module, choose M here: the
	  module will be called directional_finder.

config AD9957
        tristate "Analog Devices AD9957 DAC"
        help
          Say yes here to build support for Analog Devices AD9957 DAC chip
          ad9957, provides direct access via sysfs.

endmenu

#
# Phase-Locked Loop (PLL) frequency synthesizers
#

menu "Phase-Locked Loop (PLL) frequency synthesizers"


config ADF4159
	tristate "Analog Devices ADF4159/ADF4169 Waveform Generating Synthesizers"
	depends on SPI
	select REGMAP_SPI
	help
	  Say yes here to build support for Analog Devices ADF4159 and ADF4169
	  Direct Modulation/Fast Waveform Generating, 13 GHz,
	  Fractional-N Frequency Synthesizers.
	  The driver provides direct access via sysfs.

	  To compile this driver as a module, choose M here: the
	  module will be called adf4371.

config ADF4350
	tristate "Analog Devices ADF4350/ADF4351 Wideband Synthesizers"
	depends on SPI
	help
	  Say yes here to build support for Analog Devices  ADF4350/ADF4351
	  Wideband Synthesizers. The driver provides direct access via sysfs.

	  To compile this driver as a module, choose M here: the
	  module will be called adf4350.

config ADF4360
	tristate "Analog Devices ADF4360 Wideband Synthesizers"
	depends on SPI
	depends on COMMON_CLK
	help
	  Say yes here to build support for Analog Devices ADF4360
	  Wideband Synthesizers. The driver provides direct access via sysfs.

	  To compile this driver as a module, choose M here: the
	  module will be called adf4360.

config ADF4371
	tristate "Analog Devices ADF4371/ADF4372 Wideband Synthesizers"
	depends on SPI
	select REGMAP_SPI
	help
	  Say yes here to build support for Analog Devices ADF4371 and ADF4372
	  Wideband Synthesizers. The driver provides direct access via sysfs.

	  To compile this driver as a module, choose M here: the
	  module will be called adf4371.

config ADF4377
	tristate "Analog Devices ADF4377 Microwave Wideband Synthesizer"
	depends on SPI && COMMON_CLK
	help
	  Say yes here to build support for Analog Devices ADF4377 Microwave
	  Wideband Synthesizer.

	  To compile this driver as a module, choose M here: the
	  module will be called adf4377.

config ADF5355
	tristate "Analog Devices ADF5355/ADF4355 Wideband Synthesizers"
	depends on SPI
	depends on COMMON_CLK
	help
	  Say yes here to build support for Analog Devices ADF5355/ADF4355
	  Wideband Synthesizers. The driver provides direct access via sysfs.

	  To compile this driver as a module, choose M here: the
	  module will be called adf5355.

config LMX2582
	tristate "Texas Instruments LMX2582 driver"
	help
	  Say yes here to build support for LMX2582 driver

	  To compile this driver as a module, choose M here: the
	  module will be called lmx2582.

config LMX2594
	tristate "Texas Instruments LMX2594 driver"
	help
	  Say yes here to build support for LMX2594 driver

	  To compile this driver as a module, choose M here: the
	  module will be called lmx2594.

config HMC703
	tristate "Analog Devices HMC703 driver"
	help
	  Say yes here to build support for HMC703 driver

	  To compile this driver as a module, choose M here: the
	  module will be called hmc703.
endmenu

#
# RF Font-Ends
#

menu "RF Font-Ends"
config ADL5960
	tristate "Analog Devices ADL5960 Vector Network Analyzer Front-End"
	depends on SPI
	depends on COMMON_CLK
	depends on OF
	select REGMAP_SPI
	help
	  Say yes here to build support for Analog Devices ADL5960
	  10 MHz to 20 GHz, Integrated Vector Network Analyzer Front-End.

	  To compile this driver as a module, choose M here: the
	  module will be called adl5960.
endmenu
endmenu
```
